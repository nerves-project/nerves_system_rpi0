/dts-v1/;
/plugin/;

/{
	compatible = "brcm,bcm2835";

	fragment@0 {
		target = <&rmem>;
		__overlay__ {
			/* See arch/arm/boot/dts/bcm283x.dtsi for rmem definition. */
			#address-cells = <1>;
			#size-cells = <1>;
			ranges;

			ramoops: ramoops@b000000 {
				compatible = "ramoops";
				reg = <0x0b000000 0x100000>; /* 1 MB */
				ecc-size = <16>;
				record-size = <0x20000>; /* 128kB */
				console-size = <0x20000>;
				ftrace-size = <0>;
				pmsg-size = <0x20000>;
			};
		};
	};
};
